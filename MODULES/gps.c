#include "main.h"

#define	GPS_DATABUFFER_SIZE				(256)
uint8_t GPS_ReceiveBuffer[GPS_DATABUFFER_SIZE];
uint8_t GPS_RecDataIndex = 0;
uint8_t GPS_RecDataIndex_Old = 0;

GPS_RawData m_GPS_RawData;
GPS_Data m_GPS_Data;

unsigned char ubx_open[28]	 = {0xB5,0x62,0x06,0x00,0x14,0x00,0x01,0x00,0x00,0x00,0xC0,0x08,0x00,0x00,0x80,0x25,0x00,0x00,0x07,0x00,0x01,0x00,0x00,0x00,0x00,0x00,0x90,0xA9};
unsigned char ubx_version[28]= {0xB5,0x62,0x06,0x17,0x14,0x00,0x00,0x41,0x00,0x02,0x00,0x00,0x00,0x00,0x00,0x00,0x00,0x00,0x00,0x02,0x00,0x00,0x00,0x00,0x00,0x00,0x76,0x5C};
unsigned char ubx_gps_db[52] = {0xB5,0x62,0x06,0x3E,0x2C,0x00,0x00,0x00,0x20,0x05,0x00,0x08,0x10,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0xFD,0x25};
unsigned char ubx_gps[52]    = {0xB5,0x62,0x06,0x3E,0x2C,0x00,0x00,0x00,0x20,0x05,0x00,0x08,0x10,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0xFC,0x11};
unsigned char ubx_db[52]	 = {0xB5,0x62,0x06,0x3E,0x2C,0x00,0x00,0x00,0x20,0x05,0x00,0x08,0x10,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0xFC,0x01};
unsigned char ubx_SOL[16]	 = {0xB5,0x62,0x06,0x01,0x08,0x00,0x01,0x06,0x00,0x01,0x00,0x00,0x00,0x00,0x17,0xDA};
unsigned char ubx_VELNED[16] = {0xB5,0x62,0x06,0x01,0x08,0x00,0x01,0x12,0x00,0x01,0x00,0x00,0x00,0x00,0x23,0x2E};
unsigned char ubx_POSLLH[16] = {0xB5,0x62,0x06,0x01,0x08,0x00,0x01,0x02,0x00,0x01,0x00,0x00,0x00,0x00,0x13,0xBE};
unsigned char ubx_rate[14]	 = {0xB5,0x62,0x06,0x08,0x06,0x00,0xC8,0x00,0x01,0x00,0x01,0x00,0xDE,0x6A}; //5hz
////unsigned char ubx_rate[14]	 = {0xB5,0x62,0x06,0x08,0x06,0x00,0x64,0x00,0x01,0x00,0x01,0x00,0x7A,0x12}; //10hz
unsigned char ubx_mode[44]   = {0xB5,0x62,0x06,0x24,0x24,0x00,0xFF,0xFF,0x03,0x02,0x00,0x00,0x00,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0x15,0x9D};
unsigned char ubx_band[37]   = {0xB5,0x62,0x06,0x00,0x14,0x00,0x01,0x00,0x00,0x00,0xD0,0x08,0x00,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0x08,0x22};

void init_UBLOX(void)
{
    usart1_send_str(ubx_open, 28);
    delay_ms(100);
    usart1_send_str(ubx_version, 28);
    delay_ms(100);
    usart1_send_str(ubx_gps_db, 52);
    delay_ms(100);
    usart1_send_str(ubx_SOL, 16);
    delay_ms(100);
    usart1_send_str(ubx_VELNED, 16);
    delay_ms(100);
    usart1_send_str(ubx_POSLLH, 16);
    delay_ms(100);
//  usart1_send_str(ubx_rate, 14);
    delay_ms(100);
//	usart1_send_str(ubx_mode, 44); //将定位模式由默认的2D/3D自动切换设置成3D Only，动态模式改为Pedestrian,卫星视角改为8度
    delay_ms(100);
    usart1_send_str(ubx_band, 37);
    delay_ms(100);

}

double Convert_DDMM_to_DD(double ddmm)
{
	int tmpDD;
	double tmpDouble;
	tmpDD = (int)ddmm;
	tmpDD /= 100;
	tmpDouble = ddmm  - tmpDD;
	tmpDouble /= 60;
	return (tmpDouble + tmpDD);
}

void GPS_Handle()
{
	u32 tmpValue;
    if(GPS_RecDataIndex == 0)
    {
        return;
    }
    if(GPS_RecDataIndex != GPS_RecDataIndex_Old)
	{
		GPS_RecDataIndex_Old = GPS_RecDataIndex;
	}
	else
	{
		GPS_ReceiveBuffer[GPS_DATABUFFER_SIZE - 1] = 0;	// prevent over run
		if(GPS_ReceiveBuffer[0] != '$')
		{
			goto CLR_RET;
		}

		if(strncmp((const char *)GPS_ReceiveBuffer,"$GPGGA",6) == 0)
		{
			sscanf((const char *)GPS_ReceiveBuffer,"$GPGGA,%lf,%lf,N,%lf,E,%d,%d,",&(m_GPS_RawData.m_UTC_Position),&(m_GPS_RawData.m_Latitude),&(m_GPS_RawData.m_Longitude),&(m_GPS_RawData.m_PositionFixIndicator),&(m_GPS_RawData.m_SatellitesUsed));
		}
		else if(strncmp((const char *)GPS_ReceiveBuffer,"$GNGGA",6) == 0)
		{
			sscanf((const char *)GPS_ReceiveBuffer,"$GNGGA,%lf,%lf,N,%lf,E,%d,%d,",&(m_GPS_RawData.m_UTC_Position),&(m_GPS_RawData.m_Latitude),&(m_GPS_RawData.m_Longitude),&(m_GPS_RawData.m_PositionFixIndicator),&(m_GPS_RawData.m_SatellitesUsed));
		}
		if(m_GPS_RawData.m_SatellitesUsed > 0)
		{
			tmpValue = (u32)(m_GPS_RawData.m_UTC_Position);
			m_GPS_Data.m_UTC_Secs= (u8)(tmpValue % 0xff);
			tmpValue >>= 8;
			m_GPS_Data.m_UTC_Mins = (u8)(tmpValue % 0xff);
			tmpValue >>= 8;
			m_GPS_Data.m_UTC_Hour = (u8)(tmpValue % 0xff);
			m_GPS_Data.m_Latitude_degree = Convert_DDMM_to_DD(m_GPS_RawData.m_Latitude);
			m_GPS_Data.m_Longitude_degree = Convert_DDMM_to_DD(m_GPS_RawData.m_Longitude);
		}
CLR_RET:
		GPS_RecDataIndex = 0;
		GPS_RecDataIndex_Old = 0;
		memset(GPS_ReceiveBuffer,0,GPS_DATABUFFER_SIZE);
		// parser here
	}
}



